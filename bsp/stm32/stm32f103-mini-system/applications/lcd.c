#include <rtthread.h>
#include <rtdevice.h>
#include <drivers/spi.h>
#include "drv_spi.h"
#include <board.h>
#define WS_PIN    	GET_PIN(A, 6)
#define CS_PIN    	GET_PIN(A, 4)
#define RST_PIN		GET_PIN(A, 8)
#define LIGHT_PIN	GET_PIN(A,11)

struct rt_spi_device *spi_device;
volatile rt_uint8_t FONT[] =              // ASCII
{
	0x00,0x00,0x00,0x00,0x00, // - -

	0x00,0x00,0x5F,0x00,0x00, // -!-
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	0x55,0x2A,0x55,0x2A,0x55, // -
};
void ST7585_Write(rt_uint8_t data, rt_uint8_t cd)
{
	if (cd)
		rt_pin_write(WS_PIN, PIN_LOW);
	else
		rt_pin_write(WS_PIN, PIN_HIGH);
	rt_spi_send(spi_device, &data, 1);
}
void ST7585_Set_XY(rt_uint8_t X, rt_uint8_t Y)
{    
	ST7585_Write(0x40|Y,1);	
	ST7585_Write(0x80|X,1); 
}
void ST7585_Clear(void)
{
	rt_uint16_t i;
	ST7585_Set_XY(0,0);
	for(i = 0; i <960; i++)
	{		
		ST7585_Write(0x00,0);
	}
}
void ST7585_Write_Char(rt_uint8_t X,rt_uint8_t Y,rt_uint8_t Data)
{
	rt_uint8_t i;
	ST7585_Set_XY(X,Y);
	for(i=0;i<5;i++)
		ST7585_Write(FONT[(Data-0x20)*5+i],0);
}
void ST7585_Write_String(rt_uint8_t X,rt_uint8_t Y,rt_uint8_t *S)
{
	while(*S!=0)
	{
		ST7585_Write_Char(X,Y,*S++);
		X=X+6;
		if(X>=96)
		{
			X=0;
			Y--;
			if (Y == 0)
				Y = 7;
		}
	}
}
void Draw_bat(unsigned char level)
{
	ST7585_Set_XY(95,8);
	ST7585_Write(0x00,0);		
	ST7585_Set_XY(94,8);
	ST7585_Write(0x00,0);		
	ST7585_Set_XY(93,8);
	ST7585_Write(0x00,0);
	ST7585_Set_XY(80,8);				 //bat icon
	ST7585_Write(0xFF,0);

	if(level==0)
		return;

	ST7585_Set_XY(94,8);
	ST7585_Write(0xFF,0);

	if(level==1)
		return;

	ST7585_Set_XY(95,8);
	ST7585_Write(0xFF,0);

	if(level==2)
		return;

	ST7585_Set_XY(93,8);
	ST7585_Write(0xFF,0);
}
rt_uint8_t st7585_init(void)
{
	rt_pin_mode(WS_PIN, PIN_MODE_OUTPUT);
	rt_pin_mode(CS_PIN, PIN_MODE_OUTPUT);
	rt_pin_mode(RST_PIN, PIN_MODE_OUTPUT);
	rt_pin_mode(LIGHT_PIN, PIN_MODE_OUTPUT);
	rt_pin_write(CS_PIN, PIN_LOW);
	rt_pin_write(LIGHT_PIN, PIN_HIGH);
	rt_pin_write(RST_PIN, PIN_LOW);
	rt_thread_delay(1);
	rt_pin_write(RST_PIN, PIN_HIGH);
	rt_thread_delay(1);

	rt_err_t result = rt_hw_spi_device_attach("spi1", "spi10", GPIOA, GPIO_PIN_4); 
    if (result != RT_EOK)
    {
        rt_kprintf("lcd attach to spi1 faild, %d\n", result);
        return -2;
    }
	spi_device = (struct rt_spi_device *)rt_device_find("spi10");
	if (spi_device == RT_NULL)
	{
		rt_kprintf("spi device spi1 not found!\r\n");
		return -RT_ENOSYS;
	}

	/* config spi */
	{
		struct rt_spi_configuration cfg;
		cfg.data_width = 8;
		cfg.mode = RT_SPI_MODE_0 | RT_SPI_MSB | RT_SPI_3WIRE; /* SPI Compatible Modes 0 */
		cfg.max_hz = 20 * 1000 * 1000; /* SPI Interface with Clock Speeds Up to 20 MHz */
		rt_spi_configure(spi_device, &cfg);
	} /* config spi */
	rt_kprintf("st7585 init 4\n");

	ST7585_Write(0x21,1);    
	ST7585_Write(0x9C,1);  
	ST7585_Write(0x30,1);  
	ST7585_Write(0x20,1);   
	ST7585_Write(0x0C,1);   
	ST7585_Clear();   
	ST7585_Write_String(2,3, "Thanks Amo!");
	return 0;
}
#ifdef FINSH_USING_MSH
#include "msh.h"
#include <finsh.h>
int cmd_print(int argc, char **argv)
{
    if (argc == 4) {
		ST7585_Clear();   
		ST7585_Write_String(atoi(argv[1]), atoi(argv[2]), argv[3]);
	} else {
		rt_kprintf("wrong paramter, print 1 2 hello");
	}
    return 0;
}
FINSH_FUNCTION_EXPORT_ALIAS(cmd_print, __cmd_print, print string to lcd.);
#endif
