#include <rthw.h>
#include <rtthread.h>
#include "stm32f0xx.h"

rt_uint8_t send_data=0;
rt_uint8_t recv_data=0;
volatile rt_uint8_t FONT[] =              // ASCII
{
	0x00,0x00,0x00,0x00,0x00, // - -

	0x00,0x00,0x5F,0x00,0x00, // -!-
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	0x55,0x2A,0x55,0x2A,0x55, // --
};

void init_spi()
{
	GPIO_InitTypeDef GPIO_InitStructure;
	NVIC_InitTypeDef NVIC_InitStructure;
	SPI_InitTypeDef  SPI_InitStructure;
	/* Enable the SPI periph */
	RCC_APB2PeriphClockCmd(RCC_APB2Periph_SPI1, ENABLE);	
	/* Enable SCK, MOSI, MISO and NSS GPIO clocks */
	RCC_AHBPeriphClockCmd(RCC_AHBPeriph_GPIOA|RCC_AHBPeriph_GPIOF, ENABLE);

	GPIO_PinAFConfig(GPIOA, GPIO_PinSource5, GPIO_AF_0);//sck
	//GPIO_PinAFConfig(GPIOA, GPIO_PinSource6, GPIO_AF_0);//miso rs command or data
	GPIO_PinAFConfig(GPIOA, GPIO_PinSource7, GPIO_AF_0);//mosi
	GPIO_PinAFConfig(GPIOA, GPIO_PinSource4, GPIO_AF_0);//cs
	
	GPIO_InitStructure.GPIO_Mode = GPIO_Mode_AF;	
	GPIO_InitStructure.GPIO_OType = GPIO_OType_PP;
	GPIO_InitStructure.GPIO_PuPd  = GPIO_PuPd_DOWN;
	GPIO_InitStructure.GPIO_Speed = GPIO_Speed_Level_3;

	/* SPI SCK pin configuration */
	GPIO_InitStructure.GPIO_Pin = GPIO_Pin_5;
	GPIO_Init(GPIOA, &GPIO_InitStructure);
	/* SPI  MOSI pin configuration */
	GPIO_InitStructure.GPIO_Pin = GPIO_Pin_7;
	GPIO_Init(GPIOA, &GPIO_InitStructure);
	/* SPI NSS pin configuration */	
	GPIO_InitStructure.GPIO_Pin = GPIO_Pin_4;
	GPIO_Init(GPIOA, &GPIO_InitStructure);	
	/* SPI MISO pin configuration */	
	GPIO_InitStructure.GPIO_Mode = GPIO_Mode_OUT;	
	GPIO_InitStructure.GPIO_Pin = GPIO_Pin_6;
	GPIO_Init(GPIOA, &GPIO_InitStructure);
	/* RESET pin configuration */	
	GPIO_InitStructure.GPIO_Pin = GPIO_Pin_0;
	GPIO_Init(GPIOF, &GPIO_InitStructure);
	/* SPI configuration -------------------------------------------------------*/
	SPI_I2S_DeInit(SPI1);
	SPI_InitStructure.SPI_Direction = SPI_Direction_1Line_Tx;
	SPI_InitStructure.SPI_DataSize = SPI_DataSize_8b;
	SPI_InitStructure.SPI_CPOL = SPI_CPOL_Low;
	SPI_InitStructure.SPI_CPHA = SPI_CPHA_1Edge;
	SPI_InitStructure.SPI_NSS = SPI_NSS_Hard;
	SPI_InitStructure.SPI_BaudRatePrescaler = SPI_BaudRatePrescaler_8;
	SPI_InitStructure.SPI_FirstBit = SPI_FirstBit_MSB;
	SPI_InitStructure.SPI_CRCPolynomial = 7;

	/* Configure the SPI interrupt priority */
	NVIC_InitStructure.NVIC_IRQChannel = SPI1_IRQn;
	NVIC_InitStructure.NVIC_IRQChannelPriority = 1;
	NVIC_InitStructure.NVIC_IRQChannelCmd = ENABLE;
	NVIC_Init(&NVIC_InitStructure);

	/* Initializes the SPI communication */
	SPI_InitStructure.SPI_Mode = SPI_Mode_Master;
	SPI_Init(SPI1, &SPI_InitStructure);
	/* Initialize the FIFO threshold */
	SPI_RxFIFOThresholdConfig(SPI1, SPI_RxFIFOThreshold_QF);
	/* Enable the Rx buffer not empty interrupt */
	SPI_I2S_ITConfig(SPI1, SPI_I2S_IT_RXNE, ENABLE);
	/* Enable the SPI Error interrupt */
	SPI_I2S_ITConfig(SPI1, SPI_I2S_IT_ERR, ENABLE);
	/* Data transfer is performed in the SPI interrupt routine */
	SPI_SSOutputCmd(SPI1,ENABLE);
	//SPI_NSSPulseModeCmd(SPI1,ENABLE);
	/* Enable the SPI peripheral */
	SPI_Cmd(SPI1, ENABLE);	
}
void SPI1_IRQHandler(void)
{

  /* SPI in Master Tramitter mode--------------------------------------- */
  if (SPI_I2S_GetITStatus(SPI1, SPI_I2S_IT_TXE) == SET)
  {
    
      SPI_SendData8(SPI1, send_data);
      SPI_I2S_ITConfig(SPI1, SPI_I2S_IT_TXE, DISABLE);
     
  }
  
  /* SPI in Master Receiver mode--------------------------------------- */
  if (SPI_I2S_GetITStatus(SPI1, SPI_I2S_IT_RXNE) == SET)
  {
    recv_data=SPI_ReceiveData8(SPI1);
  }
  
  /* SPI Error interrupt--------------------------------------- */
  if (SPI_I2S_GetITStatus(SPI1, SPI_I2S_IT_OVR) == SET)
  {
    SPI_ReceiveData8(SPI1);
    SPI_I2S_GetITStatus(SPI1, SPI_I2S_IT_OVR);
  }
}
rt_uint8_t write_spi(rt_uint8_t data)
{
	send_data=data;
	/* Enable the Tx buffer empty interrupt */
	SPI_I2S_ITConfig(SPI1, SPI_I2S_IT_TXE, ENABLE);
	/* Waiting until TX FIFO is empty */
	while (SPI_GetTransmissionFIFOStatus(SPI1) != SPI_TransmissionFIFOStatus_Empty)
	{}	
}
void ST7585_Write(rt_uint8_t Data,rt_uint8_t CD)
{
	if (CD==1)
		GPIO_ResetBits(GPIOA, GPIO_Pin_6);
	else
		GPIO_SetBits(GPIOA, GPIO_Pin_6);
	write_spi(Data);
}
void ST7585_Set_XY(rt_uint8_t X, rt_uint8_t Y)
{    
	ST7585_Write(0x40|Y,1);	
	ST7585_Write(0x80|X,1); 
}
void ST7585_Clear(void)
{
	rt_uint16_t i;
	ST7585_Set_XY(0,0);
	for(i = 0; i <960; i++)
	{		
		ST7585_Write(0x00,0);
	}
}
void ST7585_Write_Char(rt_uint8_t X,rt_uint8_t Y,rt_uint8_t Data)
{
	rt_uint8_t i;
	ST7585_Set_XY(X,Y);
	for(i=0;i<5;i++)
		ST7585_Write(FONT[(Data-0x20)*5+i],0);
}
void ST7585_Write_String(rt_uint8_t X,rt_uint8_t Y,rt_uint8_t *S)
{
	while(*S!=0)
	{
		ST7585_Write_Char(X,Y,*S++);
		X=X+6;
		if(X>=96)
		{
			X=0;
			Y--;
		}
	}
}
static void delay_ms(rt_uint32_t ms)
{
    rt_uint32_t len;
    for (;ms > 0; ms --)
        for (len = 0; len < 100; len++ );
}
void Draw_bat(unsigned char level)
{
#if 0
		ST7585_Set_XY(95,8);
        ST7585_Write(0x00,0);		
		ST7585_Set_XY(94,8);
        ST7585_Write(0x00,0);		
		ST7585_Set_XY(93,8);
        ST7585_Write(0x00,0);
		ST7585_Set_XY(80,8);  
        ST7585_Write(0xFF,0);
		if(level==1)
		{
        	ST7585_Set_XY(94,8);
        	ST7585_Write(0xFF,0);
		}
		else if(level==2)
		{                
        	ST7585_Set_XY(94,8);
        	ST7585_Write(0xFF,0);
			ST7585_Set_XY(95,8);
        	ST7585_Write(0xFF,0);
		}
		else
		{	
        	ST7585_Set_XY(93,8);
        	ST7585_Write(0xFF,0);
			ST7585_Set_XY(95,8);
        	ST7585_Write(0xFF,0);
			ST7585_Set_XY(94,8);
        	ST7585_Write(0xFF,0);
		}
		#else
		
		ST7585_Set_XY(95,8);
        ST7585_Write(0x00,0);		
		ST7585_Set_XY(94,8);
        ST7585_Write(0x00,0);		
		ST7585_Set_XY(93,8);
        ST7585_Write(0x00,0);
		ST7585_Set_XY(80,8);				 //bat icon
		ST7585_Write(0xFF,0);

		if(level==0)
				return;

		ST7585_Set_XY(94,8);
		ST7585_Write(0xFF,0);

		if(level==1)
				return;
				
		ST7585_Set_XY(95,8);
		ST7585_Write(0xFF,0);

		if(level==2)
				return;
				
		ST7585_Set_XY(93,8);
		ST7585_Write(0xFF,0);

		#endif
}

int ST7585_Init(void)
{
	init_spi();
	GPIO_ResetBits(GPIOF, GPIO_Pin_0);
	delay_ms(10);                  
	GPIO_SetBits(GPIOF, GPIO_Pin_0);
	delay_ms(10);

	ST7585_Write(0x21,1);    
	ST7585_Write(0x9C,1);  
	ST7585_Write(0x30,1);  
	ST7585_Write(0x20,1);   
	ST7585_Write(0x0C,1);   
	ST7585_Clear();   
	return 0;
} 
INIT_DEVICE_EXPORT(ST7585_Init);
